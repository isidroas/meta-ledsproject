## conf/layer.conf
```bitbake
# We have a conf and classes directory, add to BBPATH
BBPATH .= ":${LAYERDIR}"

# We have recipes-* directories, add to BBFILES
BBFILES += "${LAYERDIR}/recipes-*/*/*.bb \
            ${LAYERDIR}/recipes-*/*/*.bbappend"

BBFILE_COLLECTIONS += "ledsproject"
BBFILE_PATTERN_ledsproject = "^${LAYERDIR}/"
BBFILE_PRIORITY_ledsproject = "5"
LAYERVERSION_ledsproject = "4"
LAYERSERIES_COMPAT_ledsproject = "dunfell"
```
